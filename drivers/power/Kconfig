## drivers/power/Kconfig
```kconfig
# SPDX-License-Identifier: GPL-2.0-only
source "drivers/power/avs/Kconfig"
source "drivers/power/reset/Kconfig"
source "drivers/power/supply/Kconfig"
source "drivers/power/mmi-smbcharger-iio/Kconfig"
source "drivers/power/mmi_parallel_charger_iio/Kconfig"
source "drivers/power/bq25980_mmi_iio/Kconfig"
```
