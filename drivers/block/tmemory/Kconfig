## drivers/block/tmemory/Kconfig
```kconfig
# SPDX-License-Identifier: GPL-2.0
config TMEMORY
    tristate "Tmemory write-back cache support"
    depends on BLOCK
    help
      Tmemory is a volatile write-back cache that sits between the
      filesystem and a block device (like UFS/eMMC). It absorbs random
      writes into RAM and flushes them sequentially in the background
      to improve IO performance.

      To compile this as a module, choose M here.

config TMEMORY_CRYPTO
    bool "Tmemory inline encryption support"
    depends on TMEMORY
    depends on BLK_INLINE_ENCRYPTION
    help
      Enable support for handling hardware inline encryption contexts
      (ICE/FBE) within the tmemory cache.

config TMEMORY_DEBUG
    bool "Tmemory debug logging"
    depends on TMEMORY
    help
      Enable verbose debug logging for tmemory. This will output
      many messages to the kernel log.

config TMEMORY_FAULT_INJECTION
    bool "Tmemory fault injection"
    depends on TMEMORY
    help
      Allow injecting faults (delays, alloc failures, panics) into
      tmemory for testing purposes.

config TMEMORY_MIGRATION
    bool "Tmemory page migration"
    depends on TMEMORY
    depends on TMEMORY_CRYPTO
    help
      Allow the kernel's memory reclaim to migrate tmemory cached
      pages to other physical RAM locations.

config TMEMORY_SWITCH_TIME_DEFAULT
    int "Default switch-off timeout (ms)"
    depends on TMEMORY
    default "5000"
    help
      Default time in milliseconds to wait for dirty data to flush
      when switching tmemory off before blocking new IOs.
```

## drivers/moto_mm/Kconfig
```kconfig
# SPDX-License-Identifier: GPL-2.0
config MOTO_MM
	tristate "moto mm for moto_swap"
	default y
	help
         Say Y here if you want to build moto_swap driver.

         This driver can also be built as a module.  If so, the module
         will be called moto_mm.
```

## drivers/moto_swap/Kconfig
```kconfig
# SPDX-License-Identifier: GPL-2.0
config HYBRIDSWAP_ZRAM
	tristate "Compressed RAM block device support"
	depends on BLOCK && SYSFS && ZSMALLOC && CRYPTO
	depends on CRYPTO_LZO || CRYPTO_ZSTD || CRYPTO_LZ4 || CRYPTO_LZ4HC || CRYPTO_842
	default y
	help
	  Creates virtual block devices called /dev/zramX (X = 0, 1, ...).
	  Pages written to these disks are compressed and stored in memory
	  itself. These disks allow very fast I/O and compression provides
	  good amounts of memory savings.

	  It has several use cases, for example: /tmp storage, use as swap
	  disks and maybe many more.

	  See Documentation/admin-guide/blockdev/zram.rst for more information.

choice
	prompt "Default hybridswap-zram compressor"
	default HYBRIDSWAP_ZRAM_DEF_COMP_LZORLE
	depends on HYBRIDSWAP_ZRAM

config HYBRIDSWAP_ZRAM_DEF_COMP_LZORLE
	bool "lzo-rle"
	depends on CRYPTO_LZO

config HYBRIDSWAP_ZRAM_DEF_COMP_ZSTD
	bool "zstd"
	depends on CRYPTO_ZSTD

config HYBRIDSWAP_ZRAM_DEF_COMP_LZ4
	bool "lz4"
	depends on CRYPTO_LZ4

config HYBRIDSWAP_ZRAM_DEF_COMP_LZ4HC
	bool "lz4hc"
	depends on CRYPTO_LZ4HC

config HYBRIDSWAP_ZRAM_DEF_COMP_LZO
	bool "lzo"
	depends on CRYPTO_LZO

config HYBRIDSWAP_ZRAM_DEF_COMP_842
	bool "842"
	depends on CRYPTO_842

endchoice

config HYBRIDSWAP_ZRAM_DEF_COMP
	string
	default "lzo-rle" if HYBRIDSWAP_ZRAM_DEF_COMP_LZORLE
	default "zstd" if HYBRIDSWAP_ZRAM_DEF_COMP_ZSTD
	default "lz4" if HYBRIDSWAP_ZRAM_DEF_COMP_LZ4
	default "lz4hc" if HYBRIDSWAP_ZRAM_DEF_COMP_LZ4HC
	default "lzo" if HYBRIDSWAP_ZRAM_DEF_COMP_LZO
	default "842" if HYBRIDSWAP_ZRAM_DEF_COMP_842

config HYBRIDSWAP_ZRAM_WRITEBACK
	bool "Write back incompressible or idle page to backing device"
	depends on HYBRIDSWAP_ZRAM
	help
	  With incompressible page, there is no memory saving to keep it
	  in memory. Instead, write it out to backing device.
	  For this feature, admin should set up backing device via
	  /sys/block/zramX/backing_dev.

	  With /sys/block/zramX/{idle,writeback}, application could ask
	  idle page's writeback to the backing device to save in memory.

	  See Documentation/admin-guide/blockdev/zram.rst for more information.

config HYBRIDSWAP_ZRAM_MEMORY_TRACKING
	bool "Track zRam block status"
	depends on HYBRIDSWAP_ZRAM && DEBUG_FS
	help
	  With this feature, admin can track the state of allocated blocks
	  of zRAM. Admin could see the information via
	  /sys/kernel/debug/zram/zramX/block_state.

	  See Documentation/admin-guide/blockdev/zram.rst for more information.

config HYBRIDSWAP
	bool "Enable Hybridswap"
	depends on MEMCG && HYBRIDSWAP_ZRAM && !HYBRIDSWAP_ZRAM_WRITEBACK
	default y
	help
	  Hybridswap is a intelligent memory management solution.

config HYBRIDSWAP_SWAPD
	bool "Enable hybridswap swapd thread to reclaim anon pages in background"
	default y
	depends on HYBRIDSWAP
	help
	  swapd is a kernel thread that reclaim anonymous pages in the
	  background. When the use of swap pages reaches the watermark
	  and the refault of anonymous pages is high, the content of
	  zram will exchanged to eswap by a certain percentage.

# Selected when system need hybridswap container
config HYBRIDSWAP_CORE
	bool "Hybridswap container device support"
	depends on HYBRIDSWAP_ZRAM && HYBRIDSWAP
	default y
	help
	  Say Y here if you want to use the hybridswap
	  as the backend device in ZRAM.
	  If unsure, say N here.
	  This module can't be compiled as a module,
	  the module is as one part of the ZRAM driver.
```
